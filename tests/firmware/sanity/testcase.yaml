## tests/firmware/sanity/testcase.yaml
```yaml
tests:
  wearable_recorder.sanity:
    tags:
      - wearable_recorder
      - sanity
    platform_allow:
      - native_sim
      - native_sim/native/64
    integration_platforms:
      - native_sim
    harness: ztest
    harness_config:
      type: cli
```

## tests/firmware/wr_battery/testcase.yaml
```yaml
tests:
  wearable_recorder.wr_battery:
    tags:
      - wearable_recorder
      - wr_battery
    platform_allow:
      - native_sim
      - native_sim/native/64
    integration_platforms:
      - native_sim
    harness: ztest
    harness_config:
      type: cli
```

## tests/firmware/wr_battery_service/testcase.yaml
```yaml
tests:
  wearable_recorder.wr_battery_service:
    tags:
      - wearable_recorder
      - wr_battery_service
    platform_allow:
      - native_sim
      - native_sim/native/64
    integration_platforms:
      - native_sim
    harness: ztest
    harness_config:
      type: cli
```

## tests/firmware/wr_fifo/testcase.yaml
```yaml
tests:
  wearable_recorder.wr_fifo_logic:
    tags:
      - wearable_recorder
      - wr_fifo_logic
    platform_allow:
      - native_sim
      - native_sim/native/64
    integration_platforms:
      - native_sim
    harness: ztest
    harness_config:
      type: cli
```

## tests/firmware/wr_msc_mode/testcase.yaml
```yaml
tests:
  wearable_recorder.wr_msc_mode_logic:
    tags:
      - wearable_recorder
      - wr_msc_mode_logic
    platform_allow:
      - native_sim
      - native_sim/native/64
    integration_platforms:
      - native_sim
    harness: ztest
    harness_config:
      type: cli
```

## west.yml
```yaml
# West manifest for wearable-recorder
#
# Imports nRF Connect SDK v2.9.0 which transitively pulls in Zephyr,
# modules (FATFS, ZCBOR, etc.), nrfxlib, MCUboot, and the toolchain
# integration needed to build for xiao_ble/nrf52840/sense.
#
# omi sources are vendored under third_party/omi/ as a git submodule.
#
# Usage:
#   west init -l .
#   west update --narrow -o=--depth=1
#   west build -b xiao_ble/nrf52840/sense \
#     third_party/omi/omi/firmware/devkit \
#     -- -DCONF_FILE=prj_xiao_ble_sense_devkitv1-spisd.conf
manifest:
  version: "0.13"

  remotes:
    - name: nrfconnect
      url-base: https://github.com/nrfconnect

  projects:
    - name: nrf
      remote: nrfconnect
      repo-path: sdk-nrf
      revision: v2.9.0
      import: true
```
