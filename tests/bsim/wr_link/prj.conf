## CMakeLists.txt
```
cmake_minimum_required(VERSION 3.20.0)
find_package(Zephyr REQUIRED HINTS $ENV{ZEPHYR_BASE})
project(wr_bsim_link)

target_sources(app PRIVATE
    src/main.c
    src/wr_bs_utils.c
    src/peripheral.c
    src/central.c
)

# bs_tracing.h / bs_types.h live under BSIM_OUT_PATH's component dirs;
# these aren't on Zephyr's default include path, so wire them in
# explicitly. Mirrors Zephyr's own tests/bsim/bluetooth/host/* layout.
zephyr_include_directories(
  $ENV{BSIM_COMPONENTS_PATH}/libUtilv1/src/
  $ENV{BSIM_COMPONENTS_PATH}/libPhyComv1/src/
)
```

## prj.conf
```kconfig
# Phase 5+ bsim wr_link — peripheral + central exercising the omi
# audio service over a simulated 2.4 GHz radio. Both roles share one
# binary; the test_id arg picks which role to run (see src/main.c).

# Pin pure-Zephyr LL controller (gates out nrfxlib SoftDevice — see
# tests/bsim/wr_smoke/prj.conf comments).
CONFIG_BT_LL_SW_SPLIT=y
CONFIG_BT_LL_SOFTDEVICE=n

# BLE host: we need both roles compiled in since one binary runs both
# sides depending on -testid.
CONFIG_BT=y
CONFIG_BT_PERIPHERAL=y
CONFIG_BT_CENTRAL=y
CONFIG_BT_BROADCASTER=y
CONFIG_BT_OBSERVER=y
CONFIG_BT_DEVICE_NAME="WrBsimLink"
CONFIG_BT_MAX_CONN=1

# GATT — peripheral exposes a tiny audio service with a notify char,
# central discovers + subscribes.
CONFIG_BT_GATT_DYNAMIC_DB=y
CONFIG_BT_GATT_CLIENT=y
CONFIG_BT_GATT_NOTIFY_MULTIPLE=n

# Storage filenames can be up to 64 chars (1-byte type + name in one ATT PDU).
# Default ATT MTU 23 allows only 20-byte notification payloads — too small for
# long filenames. The local ATT MTU is capped by both L2CAP TX MTU and ACL RX
# size, so keep the ACL buffers large enough for a 64-byte ATT MTU.
CONFIG_BT_L2CAP_TX_MTU=64
CONFIG_BT_BUF_ACL_RX_SIZE=68
CONFIG_BT_BUF_ACL_TX_SIZE=68

# wr_link sends an audio burst immediately followed by storage LIST/FETCH
# notifications. Match the production firmware's larger ATT/L2CAP pools so
# bsim does not starve storage responses while earlier notifications drain.
CONFIG_BT_ATT_TX_COUNT=20
CONFIG_BT_L2CAP_TX_BUF_COUNT=20

# bs_tests framework
CONFIG_LOG=y
CONFIG_LOG_BACKEND_UART=n
CONFIG_LOG_PRINTK=y
CONFIG_PRINTK=y
CONFIG_ASSERT=y
```

## src/main.c
```c
/*
 * Phase 5+ bsim wr_link — bs_tests entry point.
 *
 * Selects peripheral or central role from -testid, registers test
 * callbacks (init / tick / main), and hands control to bst_main().
 */

#include "wr_bs_utils.h"

static const struct bst_test_instance test_to_add[] = {
	{
		.test_id = "peripheral",
		.test_descr = "Advertise omi audio service, accept connection",
		.test_post_init_f = wr_test_init,
		.test_tick_f = wr_test_tick,
		.test_main_f = wr_run_peripheral,
	},
	{
		.test_id = "central",
		.test_descr = "Scan for omi audio service, connect",
		.test_post_init_f = wr_test_init,
		.test_tick_f = wr_test_tick,
		.test_main_f = wr_run_central,
	},
	BSTEST_END_MARKER,
};

static struct bst_test_list *install(struct bst_test_list *tests)
{
	return bst_add_tests(tests, test_to_add);
}

bst_test_install_t test_installers[] = { install, NULL };

int main(void)
{
	bst_main();
	return 0;
}
```

## src/central.c
```c
/*
 * Phase 5+ bsim wr_link — central side.
 *
 * Scan + connect, then discover the omi audio service, find the
 * audioCodec characteristic, subscribe to its notify, and PASS as
 * soon as the first notify arrives.
 *
 * Connection callbacks are registered with bt_conn_cb_register() at
 * runtime (not BT_CONN_CB_DEFINE()) so they only fire on the binary
 * actually running the central role — see peripheral.c for the
 * background.
 */

#include "wr_bs_utils.h"

#include <zephyr/bluetooth/gatt.h>

#define WR_LINK_EXPECT_NOTIFY_COUNT 5

DEFINE_FLAG(flag_central_connected);
DEFINE_FLAG(flag_audio_subscribed);
DEFINE_FLAG(flag_notify_received);
DEFINE_FLAG(flag_time_sync_written);
DEFINE_FLAG(flag_storage_subscribed);
DEFINE_FLAG(flag_storage_list_done);
DEFINE_FLAG(flag_storage_fetch_done);

static struct bt_conn *default_conn;
static uint32_t notify_received_count;

static struct bt_gatt_discover_params discover_params;
static struct bt_gatt_subscribe_params sub_params;
static struct bt_gatt_subscribe_params storage_sub_params;
static uint16_t storage_ctrl_handle;

/* Expected trailing bytes after the LE16 seq id: frame=0x00 + dummy 'ABCD'. */
static const uint8_t expected_tail[] = { 0x00, 'A', 'B', 'C', 'D' };
#define WR_LINK_PROBE_PAYLOAD_LEN 7  /* 2 (seq LE16) + 1 (frame) + 4 (dummy) */

static uint8_t notify_cb(struct bt_conn *conn,
			 struct bt_gatt_subscribe_params *params,
			 const void *data, uint16_t length)
{
	ARG_UNUSED(conn);
	ARG_UNUSED(params);
	if (data == NULL) {
		bs_trace_info_time(1, "central: subscription tore down\n");
		return BT_GATT_ITER_STOP;
	}

	/* Verify length before accessing bytes. */
	if (length != WR_LINK_PROBE_PAYLOAD_LEN) {
		FAIL("central: notify length %u != expected %u\n",
		     (unsigned)length, WR_LINK_PROBE_PAYLOAD_LEN);
		return BT_GATT_ITER_STOP;
	}

	const uint8_t *p = data;
	uint16_t seq_id = (uint16_t)(p[0] | (p[1] << 8));
	uint16_t expected_seq = (uint16_t)notify_received_count;

	notify_received_count++;

	/* Verify sequence id matches send order. */
	if (seq_id != expected_seq) {
		FAIL("central: notify seq=%u expected=%u\n",
		     seq_id, expected_seq);
		return BT_GATT_ITER_STOP;
	}

	/* Verify trailing sentinel bytes are intact. */
	if (memcmp(&p[2], expected_tail, sizeof(expected_tail)) != 0) {
		FAIL("central: notify #%u payload bytes corrupted\n", seq_id);
		return BT_GATT_ITER_STOP;
	}

	bs_trace_info_time(1,
		"central: notify seq=%u OK (%u bytes, total=%u)\n",
		seq_id, (unsigned)length, notify_received_count);

	if (notify_received_count >= WR_LINK_EXPECT_NOTIFY_COUNT) {
		SET_FLAG(flag_notify_received);
		return BT_GATT_ITER_STOP;
	}
	return BT_GATT_ITER_CONTINUE;
}

/* Storage stream notify handler.
 * Sets flag_storage_list_done on the first END (0x03), then
 * flag_storage_fetch_done on the second — protocol guarantees ordering. */
static uint8_t storage_notify_cb(struct bt_conn *conn,
				  struct bt_gatt_subscribe_params *params,
				  const void *data, uint16_t length)
{
	ARG_UNUSED(conn);
	ARG_UNUSED(params);

	if (data == NULL) {
		bs_trace_info_time(1, "central: storage subscription tore down\n");
		return BT_GATT_ITER_STOP;
	}
	if (length < 1) {
		return BT_GATT_ITER_CONTINUE;
	}

	const uint8_t *p = data;
	bs_trace_info_time(1, "central: storage notify type=0x%02x len=%u\n",
			   p[0], (unsigned)length);

	if (p[0] == 0x03) { /* END */
		if (!(bool)atomic_get(&flag_storage_list_done)) {
			bs_trace_info_time(1, "central: storage LIST complete\n");
			SET_FLAG(flag_storage_list_done);
		} else {
			bs_trace_info_time(1, "central: storage FETCH complete\n");
			SET_FLAG(flag_storage_fetch_done);
		}
	}
	return BT_GATT_ITER_CONTINUE;
}

/* LE64 encoding of WR_LINK_TIME_SYNC_EPOCH — written to the time-sync char. */
static const uint8_t time_sync_epoch_le[8] = {
	(uint8_t)(WR_LINK_TIME_SYNC_EPOCH & 0xff),
	(uint8_t)((WR_LINK_TIME_SYNC_EPOCH >>  8) & 0xff),
	(uint8_t)((WR_LINK_TIME_SYNC_EPOCH >> 16) & 0xff),
	(uint8_t)((WR_LINK_TIME_SYNC_EPOCH >> 24) & 0xff),
	(uint8_t)((WR_LINK_TIME_SYNC_EPOCH >> 32) & 0xff),
	(uint8_t)((WR_LINK_TIME_SYNC_EPOCH >> 40) & 0xff),
	(uint8_t)((WR_LINK_TIME_SYNC_EPOCH >> 48) & 0xff),
	(uint8_t)((WR_LINK_TIME_SYNC_EPOCH >> 56) & 0xff),
};

static uint8_t discover_cb(struct bt_conn *conn,
			   const struct bt_gatt_attr *attr,
			   struct bt_gatt_discover_params *params)
{
	if (!attr) {
		/* Discovery exhausted all handles — verify all targets found. */
		if (!(bool)atomic_get(&flag_audio_subscribed)) {
			FAIL("central: discovery ended without finding audioCodec\n");
		}
		if (!(bool)atomic_get(&flag_time_sync_written)) {
			FAIL("central: discovery ended without finding time-sync char\n");
		}
		if (!(bool)atomic_get(&flag_storage_subscribed)) {
			FAIL("central: discovery ended without finding storageStream\n");
		}
		if (storage_ctrl_handle == 0) {
			FAIL("central: discovery ended without finding storageCtrl\n");
		}
		return BT_GATT_ITER_STOP;
	}

	/* Walk all chrc declarations. attr->user_data is bt_gatt_chrc;
	 * its uuid is the chrc value's UUID (the one we care about).
	 * Mirrors zephyr/tests/bsim/bluetooth/host/gatt/notify pattern. */
	const struct bt_gatt_chrc *chrc = attr->user_data;

	/* audioCodec: subscribe, then keep walking for time-sync + storage. */
	if (bt_uuid_cmp(chrc->uuid, BT_UUID_OMI_AUDIO_CODEC) == 0) {
		bs_trace_info_time(1,
			"central: found audioCodec chrc, value_handle=%u\n",
			chrc->value_handle);
		sub_params.notify = notify_cb;
		sub_params.value = BT_GATT_CCC_NOTIFY;
		sub_params.value_handle = chrc->value_handle;
		/* CCC sits one handle past the chrc value attribute. */
		sub_params.ccc_handle = chrc->value_handle + 1;
		int err = bt_gatt_subscribe(conn, &sub_params);
		if (err && err != -EALREADY) {
			FAIL("central: subscribe failed (%d)\n", err);
			return BT_GATT_ITER_STOP;
		}
		SET_FLAG(flag_audio_subscribed);
		return BT_GATT_ITER_CONTINUE;
	}

	/* D7 time-sync char: write the fixed test epoch as LE64. */
	if (bt_uuid_cmp(chrc->uuid, BT_UUID_WR_TIME_SYNC) == 0) {
		bs_trace_info_time(1,
			"central: found time-sync chrc, value_handle=%u, writing epoch\n",
			chrc->value_handle);
		int err = bt_gatt_write_without_response(conn,
							 chrc->value_handle,
							 time_sync_epoch_le,
							 sizeof(time_sync_epoch_le),
							 false);
		if (err) {
			FAIL("central: time-sync write_without_response failed (%d)\n",
			     err);
			return BT_GATT_ITER_STOP;
		}
		SET_FLAG(flag_time_sync_written);
		return BT_GATT_ITER_CONTINUE; /* keep walking for storage */
	}

	/* Storage stream: subscribe for LIST/FETCH responses. */
	if (bt_uuid_cmp(chrc->uuid, BT_UUID_WR_STORAGE_STREAM) == 0) {
		bs_trace_info_time(1,
			"central: found storageStream chrc, value_handle=%u\n",
			chrc->value_handle);
		storage_sub_params.notify = storage_notify_cb;
		storage_sub_params.value = BT_GATT_CCC_NOTIFY;
		storage_sub_params.value_handle = chrc->value_handle;
		storage_sub_params.ccc_handle = chrc->value_handle + 1;
		int err = bt_gatt_subscribe(conn, &storage_sub_params);
		if (err && err != -EALREADY) {
			FAIL("central: storageStream subscribe failed (%d)\n", err);
			return BT_GATT_ITER_STOP;
		}
		SET_FLAG(flag_storage_subscribed);
		return BT_GATT_ITER_CONTINUE;
	}

	/* Storage ctrl: save handle for LIST/FETCH command writes. */
	if (bt_uuid_cmp(chrc->uuid, BT_UUID_WR_STORAGE_CTRL) == 0) {
		bs_trace_info_time(1,
			"central: found storageCtrl chrc, value_handle=%u\n",
			chrc->value_handle);
		storage_ctrl_handle = chrc->value_handle;
		return BT_GATT_ITER_CONTINUE;
	}

	return BT_GATT_ITER_CONTINUE;
}

static void start_discovery(struct bt_conn *conn)
{
	/* Walk all characteristics (uuid=NULL) across the connection's
	 * GATT db; the callback filters by chrc->uuid. This matches
	 * Zephyr's own bsim/host/gatt/notify reference test. */
	discover_params.uuid = NULL;
	discover_params.func = discover_cb;
	discover_params.start_handle = BT_ATT_FIRST_ATTRIBUTE_HANDLE;
	discover_params.end_handle = BT_ATT_LAST_ATTRIBUTE_HANDLE;
	discover_params.type = BT_GATT_DISCOVER_CHARACTERISTIC;

	int err = bt_gatt_discover(conn, &discover_params);
	if (err) {
		FAIL("central: bt_gatt_discover failed (%d)\n", err);
	}
}

static bool eir_found(struct bt_data *data, void *user_data)
{
	bt_addr_le_t *addr = user_data;

	if (data->type != BT_DATA_UUID128_ALL && data->type != BT_DATA_UUID128_SOME) {
		return true;
	}
	if (data->data_len % BT_UUID_SIZE_128 != 0) {
		return true;
	}

	for (size_t i = 0; i < data->data_len; i += BT_UUID_SIZE_128) {
		const uint8_t want[] = { BT_UUID_OMI_AUDIO_SERVICE_VAL };
		if (memcmp(&data->data[i], want, BT_UUID_SIZE_128) != 0) {
			continue;
		}

		bs_trace_info_time(1, "central: found omi peer, connecting\n");
		int err = bt_le_scan_stop();
		if (err && err != -EALREADY) {
			FAIL("central: bt_le_scan_stop failed (%d)\n", err);
			return false;
		}
		err = bt_conn_le_create(addr, BT_CONN_LE_CREATE_CONN,
					BT_LE_CONN_PARAM_DEFAULT, &default_conn);
		if (err) {
			FAIL("central: bt_conn_le_create failed (%d)\n", err);
			return false;
		}
		return false;
	}
	return true;
}

static void device_found(const bt_addr_le_t *addr, int8_t rssi, uint8_t type,
			 struct net_buf_simple *ad)
{
	if (type != BT_GAP_ADV_TYPE_ADV_IND &&
	    type != BT_GAP_ADV_TYPE_ADV_DIRECT_IND) {
		return;
	}
	bt_data_parse(ad, eir_found, (void *)addr);
}

static void mtu_exchange_cb(struct bt_conn *conn, uint8_t att_err,
			     struct bt_gatt_exchange_params *params)
{
	ARG_UNUSED(params);
	bs_trace_info_time(1, "central: MTU exchange %s (att_err=%u)\n",
			   att_err ? "failed" : "ok", att_err);
	start_discovery(conn);
}

static struct bt_gatt_exchange_params mtu_params = {
	.func = mtu_exchange_cb,
};

static void central_connected(struct bt_conn *conn, uint8_t err)
{
	if (err) {
		FAIL("central: connection failed (%u)\n", err);
		return;
	}
	bs_trace_info_time(1, "central: connected, exchanging MTU\n");
	SET_FLAG(flag_central_connected);
	int mtu_err = bt_gatt_exchange_mtu(conn, &mtu_params);
	if (mtu_err) {
		/* Fall back to discovery at default MTU if exchange fails. */
		bs_trace_info_time(1, "central: MTU exchange start failed (%d), "
				      "proceeding with default MTU\n", mtu_err);
		start_discovery(conn);
	}
}

static void central_disconnected(struct bt_conn *conn, uint8_t reason)
{
	bs_trace_info_time(1, "central: disconnected (reason 0x%02x)\n",
			   reason);
	if (default_conn) {
		bt_conn_unref(default_conn);
		default_conn = NULL;
	}
}

static struct bt_conn_cb central_cb = {
	.connected = central_connected,
	.disconnected = central_disconnected,
};

void wr_run_central(void)
{
	int err = bt_enable(NULL);
	if (err) {
		FAIL("central: bt_enable failed (%d)\n", err);
		return;
	}
	bt_conn_cb_register(&central_cb);

	struct bt_le_scan_param scan_param = {
		.type     = BT_LE_SCAN_TYPE_ACTIVE,
		.options  = BT_LE_SCAN_OPT_NONE,
		.interval = BT_GAP_SCAN_FAST_INTERVAL,
		.window   = BT_GAP_SCAN_FAST_WINDOW,
	};
	err = bt_le_scan_start(&scan_param, device_found);
	if (err) {
		FAIL("central: bt_le_scan_start failed (%d)\n", err);
		return;
	}
	bs_trace_info_time(1, "central: scanning for omi audio service\n");

	WAIT_FOR_FLAG(flag_central_connected);
	WAIT_FOR_FLAG(flag_audio_subscribed);
	WAIT_FOR_FLAG(flag_notify_received);
	WAIT_FOR_FLAG(flag_time_sync_written);
	WAIT_FOR_FLAG(flag_storage_subscribed);

	/* Storage LIST: send 0x00 to storageCtrl, wait for END notify. */
	uint8_t list_cmd = 0x00;
	err = bt_gatt_write_without_response(default_conn, storage_ctrl_handle,
					     &list_cmd, sizeof(list_cmd), false);
	if (err) {
		FAIL("central: storage LIST write failed (%d)\n", err);
		return;
	}
	bs_trace_info_time(1, "central: storage LIST command sent\n");
	WAIT_FOR_FLAG(flag_storage_list_done);

	/* Storage FETCH: send 0x01 to storageCtrl, wait for END notify. */
	uint8_t fetch_cmd = 0x01;
	err = bt_gatt_write_without_response(default_conn, storage_ctrl_handle,
					     &fetch_cmd, sizeof(fetch_cmd), false);
	if (err) {
		FAIL("central: storage FETCH write failed (%d)\n", err);
		return;
	}
	bs_trace_info_time(1, "central: storage FETCH command sent\n");
	WAIT_FOR_FLAG(flag_storage_fetch_done);

	PASS("central: link + %u-packet burst + time-sync + storage LIST + FETCH\n",
	     WR_LINK_EXPECT_NOTIFY_COUNT);
}
```

## src/peripheral.c
```c
/*
 * Phase 5+ bsim wr_link — peripheral side.
 *
 * Advertise the omi audio service, accept the central's connection,
 * notify a single sentinel packet on the audioCodec characteristic,
 * then PASS.
 *
 * Connection callbacks are registered with bt_conn_cb_register() at
 * runtime instead of BT_CONN_CB_DEFINE(). With link-time registration
 * the central role's callbacks (also linked into the same binary)
 * fire on the peripheral's connect event and trigger work that wasn't
 * initialised on this side — kernel panic. Dynamic registration keeps
 * the policy tied to the role that's actually active.
 */

#include "wr_bs_utils.h"

#include <zephyr/bluetooth/gatt.h>
#include <errno.h>
#include <string.h>

#define WR_LINK_BURST_COUNT 5
#define WR_LINK_BURST_INTERVAL_MS 50
#define WR_STORAGE_NOTIFY_RETRIES 20
#define WR_STORAGE_NOTIFY_RETRY_MS 20

DEFINE_FLAG(flag_peer_connected);
DEFINE_FLAG(flag_notify_sent);
DEFINE_FLAG(flag_time_sync_received);
DEFINE_FLAG(flag_storage_list_handled);
DEFINE_FLAG(flag_storage_fetch_handled);

static struct bt_conn *peer_conn;
static struct k_work_delayable notify_work;
static uint16_t notify_seq;

/* Storage GATT: command received from central, queued to work queue. */
static uint8_t  storage_cmd;
static struct k_work storage_resp_work;

static const struct bt_data ad[] = {
	BT_DATA_BYTES(BT_DATA_FLAGS, (BT_LE_AD_GENERAL | BT_LE_AD_NO_BREDR)),
	BT_DATA_BYTES(BT_DATA_UUID128_ALL, BT_UUID_OMI_AUDIO_SERVICE_VAL),
};

static void ccc_cfg_changed(const struct bt_gatt_attr *attr, uint16_t value)
{
	bs_trace_info_time(1, "peripheral: CCC changed -> 0x%04x\n", value);
	/* Fire the notify only once the central has actually subscribed
	 * (CCC value bit BT_GATT_CCC_NOTIFY set). Otherwise bt_gatt_notify
	 * returns -EINVAL with the "Device is not subscribed" warning. */
	if ((value & BT_GATT_CCC_NOTIFY) != 0) {
		k_work_schedule(&notify_work, K_MSEC(20));
	}
}

BT_GATT_SERVICE_DEFINE(audio_svc,
	BT_GATT_PRIMARY_SERVICE(BT_UUID_OMI_AUDIO_SERVICE),
	BT_GATT_CHARACTERISTIC(BT_UUID_OMI_AUDIO_CODEC,
			       BT_GATT_CHRC_NOTIFY,
			       BT_GATT_PERM_NONE,
			       NULL, NULL, NULL),
	BT_GATT_CCC(ccc_cfg_changed,
		    BT_GATT_PERM_READ | BT_GATT_PERM_WRITE),
);

/* ---------------------------------------------------------------
 * Storage GATT service — bsim test stub.
 *
 * Mirrors the protocol in app/src/wr_storage_service.c:
 *   LIST (0x00) → FILE_ENTRY × 2 + END
 *   FETCH (0x01 + name) → DATA × 1 + END
 * Responses are sent from a work queue handler (not from the write
 * callback) to keep the BLE RX thread unblocked.
 * --------------------------------------------------------------- */

static ssize_t storage_ctrl_write_cb(struct bt_conn *conn,
				     const struct bt_gatt_attr *attr,
				     const void *buf, uint16_t len,
				     uint16_t offset, uint8_t flags)
{
	ARG_UNUSED(attr);
	ARG_UNUSED(offset);
	ARG_UNUSED(flags);

	if (len == 0) {
		return BT_GATT_ERR(BT_ATT_ERR_INVALID_ATTRIBUTE_LEN);
	}

	storage_cmd = ((const uint8_t *)buf)[0];
	k_work_submit(&storage_resp_work);
	return (ssize_t)len;
}

static void storage_stream_ccc_changed(const struct bt_gatt_attr *attr,
				       uint16_t value)
{
	bs_trace_info_time(1, "peripheral: storage stream CCC -> 0x%04x\n", value);
}

BT_GATT_SERVICE_DEFINE(storage_svc,
	BT_GATT_PRIMARY_SERVICE(BT_UUID_WR_STORAGE_SVC),
	BT_GATT_CHARACTERISTIC(BT_UUID_WR_STORAGE_STREAM,
			       BT_GATT_CHRC_NOTIFY,
			       BT_GATT_PERM_NONE,
			       NULL, NULL, NULL),
	BT_GATT_CCC(storage_stream_ccc_changed,
		    BT_GATT_PERM_READ | BT_GATT_PERM_WRITE),
	BT_GATT_CHARACTERISTIC(BT_UUID_WR_STORAGE_CTRL,
			       BT_GATT_CHRC_WRITE_WITHOUT_RESP,
			       BT_GATT_PERM_WRITE,
			       NULL, storage_ctrl_write_cb, NULL),
);
/* storage_svc.attrs[2] = storageStream value (used with bt_gatt_notify). */

static void storage_notify_done(struct bt_conn *conn, void *user_data)
{
	ARG_UNUSED(conn);

	struct k_sem *done = user_data;
	k_sem_give(done);
}

static int storage_notify_with_retry(struct bt_conn *conn,
				     const void *data, uint16_t len)
{
	int err = 0;
	struct k_sem done;
	struct bt_gatt_notify_params params = {
		.attr = &storage_svc.attrs[2],
		.data = data,
		.len = len,
		.func = storage_notify_done,
		.user_data = &done,
	};

	for (int attempt = 0; attempt < WR_STORAGE_NOTIFY_RETRIES; attempt++) {
		k_sem_init(&done, 0, 1);

		err = bt_gatt_notify_cb(conn, &params);
		if (err == 0) {
			k_sem_take(&done, K_FOREVER);
			return 0;
		}

		if (err != -ENOMEM && err != -EAGAIN) {
			return err;
		}

		k_msleep(WR_STORAGE_NOTIFY_RETRY_MS);
	}

	return err;
}

static void storage_resp_worker(struct k_work *work)
{
	ARG_UNUSED(work);

	struct bt_conn *conn = peer_conn;

	if (!conn) {
		return;
	}

	if (storage_cmd == 0x00) {
		/* LIST: send FILE_ENTRY for each test file, then END. */
		const char *files[] = {
			WR_STORAGE_TEST_FILE_1,
			WR_STORAGE_TEST_FILE_2,
		};
		for (int i = 0; i < 2; i++) {
			uint8_t buf[1 + 64];
			size_t nlen = strlen(files[i]);
			buf[0] = 0x01; /* FILE_ENTRY */
			memcpy(&buf[1], files[i], nlen);
			int err = storage_notify_with_retry(
				conn, buf, (uint16_t)(1 + nlen));
			if (err) {
				FAIL("peripheral: storage LIST notify failed (%d)\n",
				     err);
				return;
			}
			k_msleep(10);
		}
		uint8_t end = 0x03;
		int err = storage_notify_with_retry(conn, &end, 1);
		if (err) {
			FAIL("peripheral: storage LIST END notify failed (%d)\n",
			     err);
			return;
		}
		bs_trace_info_time(1, "peripheral: storage LIST sent (2 entries + END)\n");
		SET_FLAG(flag_storage_list_handled);

	} else if (storage_cmd == 0x01) {
		/* FETCH: send DATA chunk, then END. */
		uint8_t data[] = WR_STORAGE_TEST_DATA;
		uint8_t buf[1 + WR_STORAGE_TEST_DATA_LEN];
		buf[0] = 0x02; /* DATA */
		memcpy(&buf[1], data, WR_STORAGE_TEST_DATA_LEN);
		int err = storage_notify_with_retry(
			conn, buf, (uint16_t)sizeof(buf));
		if (err) {
			FAIL("peripheral: storage FETCH notify failed (%d)\n", err);
			return;
		}
		k_msleep(10);
		uint8_t end = 0x03;
		err = storage_notify_with_retry(conn, &end, 1);
		if (err) {
			FAIL("peripheral: storage FETCH END notify failed (%d)\n",
			     err);
			return;
		}
		bs_trace_info_time(1, "peripheral: storage FETCH sent (data + END)\n");
		SET_FLAG(flag_storage_fetch_handled);
	}
}

/* D7 time-sync service: single WRITE_WITHOUT_RESP characteristic.
 * Mirrors app/src/wr_time_sync.c — service UUID doubles as char UUID. */
static ssize_t time_sync_write(struct bt_conn *conn,
			       const struct bt_gatt_attr *attr,
			       const void *buf, uint16_t len,
			       uint16_t offset, uint8_t flags)
{
	ARG_UNUSED(conn);
	ARG_UNUSED(attr);
	ARG_UNUSED(offset);
	ARG_UNUSED(flags);

	if (len != sizeof(uint64_t)) {
		FAIL("peripheral: time-sync write: expected 8 bytes, got %u\n",
		     (unsigned)len);
		return BT_GATT_ERR(BT_ATT_ERR_INVALID_ATTRIBUTE_LEN);
	}

	uint64_t epoch;
	memcpy(&epoch, buf, sizeof(epoch));

	bs_trace_info_time(1,
		"peripheral: time-sync epoch received: 0x%016llx\n",
		(unsigned long long)epoch);

	if (epoch != WR_LINK_TIME_SYNC_EPOCH) {
		FAIL("peripheral: epoch 0x%016llx != expected 0x%016llx\n",
		     (unsigned long long)epoch,
		     (unsigned long long)WR_LINK_TIME_SYNC_EPOCH);
		return BT_GATT_ERR(BT_ATT_ERR_VALUE_NOT_ALLOWED);
	}

	SET_FLAG(flag_time_sync_received);
	return (ssize_t)len;
}

BT_GATT_SERVICE_DEFINE(time_sync_svc,
	BT_GATT_PRIMARY_SERVICE(BT_UUID_WR_TIME_SYNC),
	BT_GATT_CHARACTERISTIC(BT_UUID_WR_TIME_SYNC,
			       BT_GATT_CHRC_WRITE_WITHOUT_RESP,
			       BT_GATT_PERM_WRITE,
			       NULL, time_sync_write, NULL),
);

static void notify_worker(struct k_work *work)
{
	ARG_UNUSED(work);

	if (!peer_conn) {
		FAIL("peripheral: notify_worker fired without a connection\n");
		return;
	}

	/* Build a packet whose first 2 bytes are the LE16 sequence id;
	 * mirrors omi audio packet header layout (packet_id + frame_id +
	 * payload). The central counts how many it sees, so we just need
	 * each one to be a legal payload. */
	uint8_t payload[] = WR_LINK_PROBE_PAYLOAD;
	payload[0] = (uint8_t)(notify_seq & 0xff);
	payload[1] = (uint8_t)((notify_seq >> 8) & 0xff);

	int err = bt_gatt_notify(peer_conn, &audio_svc.attrs[1],
				 payload, sizeof(payload));
	if (err) {
		FAIL("peripheral: bt_gatt_notify[%u] failed (%d)\n",
		     notify_seq, err);
		return;
	}
	bs_trace_info_time(1, "peripheral: sent notify #%u (%u bytes)\n",
			   notify_seq, (unsigned)sizeof(payload));
	notify_seq++;

	if (notify_seq < WR_LINK_BURST_COUNT) {
		k_work_schedule(&notify_work,
				K_MSEC(WR_LINK_BURST_INTERVAL_MS));
	} else {
		bs_trace_info_time(1,
			"peripheral: burst complete (%u packets)\n",
			WR_LINK_BURST_COUNT);
		SET_FLAG(flag_notify_sent);
	}
}

static void peripheral_connected(struct bt_conn *conn, uint8_t err)
{
	if (err) {
		FAIL("peripheral: connection failed (%u)\n", err);
		return;
	}
	bs_trace_info_time(1, "peripheral: connected\n");
	peer_conn = bt_conn_ref(conn);
	SET_FLAG(flag_peer_connected);
	/* Don't notify yet — wait for the central to write the CCC
	 * descriptor, which fires ccc_cfg_changed and schedules the
	 * notify_work. Race-free even on bsim's compressed clock. */
}

static void peripheral_disconnected(struct bt_conn *conn, uint8_t reason)
{
	bs_trace_info_time(1, "peripheral: disconnected (reason 0x%02x)\n",
			   reason);
	if (peer_conn) {
		bt_conn_unref(peer_conn);
		peer_conn = NULL;
	}
}

static struct bt_conn_cb peripheral_cb = {
	.connected = peripheral_connected,
	.disconnected = peripheral_disconnected,
};

void wr_run_peripheral(void)
{
	int err = bt_enable(NULL);
	if (err) {
		FAIL("peripheral: bt_enable failed (%d)\n", err);
		return;
	}
	bt_conn_cb_register(&peripheral_cb);
	k_work_init_delayable(&notify_work, notify_worker);
	k_work_init(&storage_resp_work, storage_resp_worker);

	err = bt_le_adv_start(BT_LE_ADV_CONN, ad, ARRAY_SIZE(ad), NULL, 0);
	if (err) {
		FAIL("peripheral: bt_le_adv_start failed (%d)\n", err);
		return;
	}
	bs_trace_info_time(1, "peripheral: advertising as 'WrBsimLink'\n");

	WAIT_FOR_FLAG(flag_peer_connected);
	WAIT_FOR_FLAG(flag_notify_sent);
	WAIT_FOR_FLAG(flag_time_sync_received);
	WAIT_FOR_FLAG(flag_storage_list_handled);
	WAIT_FOR_FLAG(flag_storage_fetch_handled);
	PASS("peripheral: link + notify burst + time-sync + storage LIST + FETCH handled\n");
}
```

## src/wr_bs_utils.c
```c
/*
 * Phase 5+ bsim wr_link — shared helpers (test framework hooks + flags).
 */

#include "wr_bs_utils.h"

#define BS_SECONDS(s)         ((bs_time_t)(s) * USEC_PER_SEC)
#define WR_LINK_SIM_TIMEOUT   BS_SECONDS(15)

void wr_test_init(void)
{
	bst_ticker_set_next_tick_absolute(WR_LINK_SIM_TIMEOUT);
	bst_result = In_progress;
}

void wr_test_tick(bs_time_t HW_device_time)
{
	if (bst_result != Passed) {
		bst_result = Failed;
		bs_trace_error_line(
			"wr_link: simulation timed out before role hit PASS()\n");
	}
}
```

## src/wr_bs_utils.h
```c
/*
 * Phase 5+ bsim wr_link — shared helpers (test framework hooks + flags).
 *
 * Lifted from Zephyr's tests/bsim/bluetooth/host/adv/resume/src/bs_bt_utils.h
 * and trimmed to what wr_link needs. We intentionally avoid the
 * backchannel helpers — peripheral and central don't need to coordinate
 * out-of-band beyond the radio link itself.
 */

#ifndef WR_BS_UTILS_H
#define WR_BS_UTILS_H

#include "bs_tracing.h"
#include "bs_types.h"
#include "bstests.h"

#include <zephyr/bluetooth/bluetooth.h>
#include <zephyr/bluetooth/conn.h>
#include <zephyr/bluetooth/uuid.h>
#include <zephyr/kernel.h>
#include <zephyr/sys/atomic.h>

extern enum bst_result_t bst_result;

#define DECLARE_FLAG(flag) extern atomic_t flag
#define DEFINE_FLAG(flag)  atomic_t flag = (atomic_t)false
#define SET_FLAG(flag)     ((void)atomic_set(&(flag), (atomic_t)true))
#define UNSET_FLAG(flag)   ((void)atomic_set(&(flag), (atomic_t)false))
#define WAIT_FOR_FLAG(flag) \
	while (!(bool)atomic_get(&(flag))) { \
		k_sleep(K_MSEC(1)); \
	}

#define FAIL(...) \
	do { \
		bst_result = Failed; \
		bs_trace_error_time_line(__VA_ARGS__); \
	} while (0)

#define PASS(...) \
	do { \
		bst_result = Passed; \
		bs_trace_info_time(1, __VA_ARGS__); \
	} while (0)

/* omi audio service primary UUID (mirrors transport.c). */
#define BT_UUID_OMI_AUDIO_SERVICE_VAL \
	BT_UUID_128_ENCODE(0x19B10000, 0xE8F2, 0x537E, 0x4F6C, 0xD104768A1214)
#define BT_UUID_OMI_AUDIO_SERVICE \
	BT_UUID_DECLARE_128(BT_UUID_OMI_AUDIO_SERVICE_VAL)

/* audioCodec characteristic (notify) — the path the firmware streams
 * Opus packets over (3 byte header + payload). For the bsim notify
 * exchange test we just notify a known short payload and verify the
 * central receives it. */
#define BT_UUID_OMI_AUDIO_CODEC_VAL \
	BT_UUID_128_ENCODE(0x19B10002, 0xE8F2, 0x537E, 0x4F6C, 0xD104768A1214)
#define BT_UUID_OMI_AUDIO_CODEC \
	BT_UUID_DECLARE_128(BT_UUID_OMI_AUDIO_CODEC_VAL)

/* Sentinel payload the peripheral notifies once after connect.
 * Mirrors omi packet header layout: packet_id LE16 + frame_id u8. */
#define WR_LINK_PROBE_PAYLOAD \
	{ 0x42, 0x00, 0x00, /* header: pkt 0x0042, frame 0 */ \
	  'A', 'B', 'C', 'D' /* dummy "Opus" payload */ }

/* D7 time-sync write characteristic (UUID 19B10005-...).
 * Service UUID doubles as the characteristic UUID — single-char service,
 * mirrors app/src/wr_time_sync.c. Central writes 8-byte LE64 Unix epoch;
 * peripheral echoes it back as a GATT indication and validates content. */
#define BT_UUID_WR_TIME_SYNC_VAL \
	BT_UUID_128_ENCODE(0x19B10005, 0xE8F2, 0x537E, 0x4F6C, 0xD104768A1214)
#define BT_UUID_WR_TIME_SYNC \
	BT_UUID_DECLARE_128(BT_UUID_WR_TIME_SYNC_VAL)

/* Fixed test epoch used by the central; peripheral validates the received value.
 * LE64 bytes: {0x08, 0x07, 0x06, 0x05, 0x04, 0x03, 0x02, 0x01}. */
#define WR_LINK_TIME_SYNC_EPOCH 0x0102030405060708ULL

/* Storage GATT service UUIDs (mirrors wr_storage_service.c). */
#define BT_UUID_WR_STORAGE_SVC_VAL \
	BT_UUID_128_ENCODE(0x30295780, 0x4301, 0xEABD, 0x2904, 0x2849ADFEAE43)
#define BT_UUID_WR_STORAGE_STREAM_VAL \
	BT_UUID_128_ENCODE(0x30295781, 0x4301, 0xEABD, 0x2904, 0x2849ADFEAE43)
#define BT_UUID_WR_STORAGE_CTRL_VAL \
	BT_UUID_128_ENCODE(0x30295782, 0x4301, 0xEABD, 0x2904, 0x2849ADFEAE43)
#define BT_UUID_WR_STORAGE_SVC    BT_UUID_DECLARE_128(BT_UUID_WR_STORAGE_SVC_VAL)
#define BT_UUID_WR_STORAGE_STREAM BT_UUID_DECLARE_128(BT_UUID_WR_STORAGE_STREAM_VAL)
#define BT_UUID_WR_STORAGE_CTRL   BT_UUID_DECLARE_128(BT_UUID_WR_STORAGE_CTRL_VAL)

/* Synthetic file list the peripheral returns for the bsim LIST scenario. */
#define WR_STORAGE_TEST_FILE_1     "1700000000.opus"
#define WR_STORAGE_TEST_FILE_2     "unsynced_ab12_00000.opus"

/* Synthetic file data the peripheral returns for the bsim FETCH scenario. */
#define WR_STORAGE_TEST_DATA       { 0xDE, 0xAD, 0xBE, 0xEF, 0x01, 0x02 }
#define WR_STORAGE_TEST_DATA_LEN   6

void wr_test_init(void);
void wr_test_tick(bs_time_t HW_device_time);

void wr_run_peripheral(void);
void wr_run_central(void);

#endif /* WR_BS_UTILS_H */
```
