## CMakeLists.txt
```
# SPDX-License-Identifier: Apache-2.0
cmake_minimum_required(VERSION 3.20.0)

find_package(Zephyr REQUIRED HINTS $ENV{ZEPHYR_BASE})
project(wearable_recorder)

target_sources(app PRIVATE
    src/main.c
    src/led.c
)
target_include_directories(app PRIVATE src)
```

## Kconfig
```
mainmenu "wearable-recorder firmware"

source "Kconfig.zephyr"

menu "Wearable Recorder application options"

config WR_DEV_BUILD
	bool "Development build (longer WDT, verbose logs)"
	default y
	help
	  Enable development-friendly defaults: 5-minute watchdog timeout
	  instead of 30 seconds, INFO-level application logs. Disable for
	  production builds.

config WR_WDT_TIMEOUT_MS
	int "Watchdog timeout (ms)"
	default 300000 if WR_DEV_BUILD
	default 30000
	help
	  Timeout in milliseconds for the kernel watchdog. The main loop
	  must call wdt_feed() faster than this or the SoC resets.

endmenu
```

## prj.conf
```kconfig
# Wearable Recorder firmware — bring-up profile
#
# Goals at this stage:
#   1. Board boots
#   2. USB CDC ACM provides /dev/ttyACM0 console
#   3. Green LED blinks
#   4. printk / LOG_INF reaches host

# --- Logging --------------------------------------------------------------
CONFIG_LOG=y
CONFIG_LOG_MODE_DEFERRED=y
CONFIG_LOG_BUFFER_SIZE=8192
CONFIG_LOG_MODE_OVERFLOW=y

# --- USB CDC ACM (console) ------------------------------------------------
# Console routed to usb_cdc_acm_uart by xiao_ble_common.dtsi via
# zephyr,console = &usb_cdc_acm_uart.
CONFIG_SERIAL=y
CONFIG_UART_INTERRUPT_DRIVEN=y
CONFIG_UART_LINE_CTRL=y
CONFIG_USB_DEVICE_STACK=y
CONFIG_USB_DEVICE_PRODUCT="wearable-recorder"
CONFIG_USB_DEVICE_VID=0x2FE3
CONFIG_USB_DEVICE_PID=0x0008
# Enlarge CDC TX ring so early-boot log burst doesn't fill it before host
# enumerates and reads. Default in NCS v2.7 is 1024.
CONFIG_USB_CDC_ACM_RINGBUF_SIZE=8192
# Don't auto-init: we call usb_enable() from main after waiting for DTR
# so output isn't lost.
CONFIG_USB_DEVICE_INITIALIZE_AT_BOOT=n

# --- Reboot syscall -------------------------------------------------------
CONFIG_REBOOT=y

# --- GPIO -----------------------------------------------------------------
CONFIG_GPIO=y

# --- Power management (XIAO BLE Sense onboard QSPI flash uses pm_device) --
CONFIG_PM_DEVICE=y

# --- printk for early bring-up via printf ---------------------------------
CONFIG_PRINTK=y
```

## boards/xiao_ble_nrf52840_sense.overlay
```dts
/*
 * Wearable Recorder — XIAO BLE Sense board overlay (bring-up profile).
 *
 * For now this only ensures USB CDC ACM is available as the console.
 * SPI SD wiring, PDM mic, and PTT button are added in later tasks.
 */

/ {
	chosen {
		/* Default console / shell already point to usb_cdc_acm_uart in
		 * xiao_ble_common.dtsi; keep that mapping. */
	};
};
```

## src/main.c
```c
/* Wearable Recorder — application entry point.
 *
 * Bring-up profile: blink the green LED, log over USB CDC ACM. Later
 * tasks add SD mount, BLE peripheral, audio capture, recording state
 * machine.
 */
#include <zephyr/kernel.h>
#include <zephyr/logging/log.h>
#include <zephyr/usb/usb_device.h>
#include <zephyr/drivers/uart.h>
#include <zephyr/device.h>

#include "led.h"

LOG_MODULE_REGISTER(main, LOG_LEVEL_INF);

#define BLINK_PERIOD_MS 500

static int wait_for_dtr(void)
{
	const struct device *uart = DEVICE_DT_GET(DT_CHOSEN(zephyr_console));
	if (!device_is_ready(uart)) {
		return -ENODEV;
	}
	uint32_t dtr = 0;
	/* Wait up to 5 s for a host to assert DTR; otherwise continue
	 * unconnected so the firmware doesn't hang during a power-only
	 * boot (no USB host attached). */
	for (int i = 0; i < 50 && !dtr; i++) {
		(void)uart_line_ctrl_get(uart, UART_LINE_CTRL_DTR, &dtr);
		k_msleep(100);
	}
	return 0;
}

int main(void)
{
	int ret = usb_enable(NULL);
	if (ret) {
		/* USB might already be enabled by another subsystem; that's fine. */
		LOG_WRN("usb_enable returned %d (continuing)", ret);
	}
	(void)wait_for_dtr();

	LOG_INF("=========================================");
	LOG_INF(" wearable-recorder firmware (scratch v0)");
	LOG_INF("=========================================");
	LOG_INF("Build: " __DATE__ " " __TIME__);

	if (wr_led_init() != 0) {
		LOG_ERR("LED init failed; halting");
		return 0;
	}

	uint32_t tick = 0;
	while (1) {
		wr_led_toggle();
		if ((tick % 10) == 0) {
			LOG_INF("alive tick=%u", tick);
		}
		tick++;
		k_msleep(BLINK_PERIOD_MS);
	}
	return 0;
}
```

## src/led.c
```c
/* Status LED driver — single GPIO LED, active low.
 *
 * On XIAO BLE Sense the green LED is led1 (P0.30, GPIO_ACTIVE_LOW).
 * We drive it as a status indicator: bring-up blink, then later
 * idle/connected/recording patterns from recorder.c.
 */
#include "led.h"

#include <zephyr/device.h>
#include <zephyr/devicetree.h>
#include <zephyr/drivers/gpio.h>
#include <zephyr/logging/log.h>

LOG_MODULE_REGISTER(wr_led, LOG_LEVEL_INF);

#define WR_LED_NODE DT_ALIAS(led1)

static const struct gpio_dt_spec led_spec = GPIO_DT_SPEC_GET(WR_LED_NODE, gpios);

int wr_led_init(void)
{
	if (!gpio_is_ready_dt(&led_spec)) {
		LOG_ERR("LED GPIO not ready");
		return -ENODEV;
	}
	int ret = gpio_pin_configure_dt(&led_spec, GPIO_OUTPUT_INACTIVE);
	if (ret < 0) {
		LOG_ERR("LED gpio_pin_configure_dt: %d", ret);
		return ret;
	}
	LOG_INF("LED initialised (green, %s pin %u)", led_spec.port->name, led_spec.pin);
	return 0;
}

int wr_led_set(bool on)
{
	return gpio_pin_set_dt(&led_spec, on ? 1 : 0);
}

int wr_led_toggle(void)
{
	return gpio_pin_toggle_dt(&led_spec);
}
```

## src/led.h
```c
#ifndef WR_LED_H
#define WR_LED_H

#include <stdbool.h>

/* Initialise the status LED (green). Returns 0 on success. */
int wr_led_init(void);

/* Drive the LED on/off explicitly. */
int wr_led_set(bool on);

/* Toggle the LED (used during bring-up blink). */
int wr_led_toggle(void);

#endif /* WR_LED_H */
```
